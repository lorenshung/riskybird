## CMakeLists.txt
```
# SPDX-License-Identifier: Apache-2.0

cmake_minimum_required(VERSION 3.20.0)

find_package(Zephyr REQUIRED HINTS $ENV{ZEPHYR_BASE})
project(esp_bridge)

target_sources(app PRIVATE src/main.c src/load_link.c src/persist.c src/esp_safety.c)

# The sensor relay (motors build): compiled only when the motors overlay declares its nodes.
if(CONFIG_SENSOR)
  target_sources(app PRIVATE src/sensor_relay.c)
endif()

# The motor duty-frame wire format is a contract shared with the FPGA flight
# controller and with workloads/esp_motors, so it lives in integration/ and every
# end compiles the same header rather than each keeping a copy that can drift.
#
# Added unconditionally even though only the `motors` build includes the header:
# the include path is harmless in the default build (nothing includes it, and
# HAVE_MOTORS compiles the whole motor half out), and making it conditional would
# mean the two builds disagree about their include paths, which is exactly the
# kind of difference that turns "works in the bridge build" into a link error in
# the one that drives motors.
set(RB_MOTOR_LINK_DIR ${CMAKE_CURRENT_SOURCE_DIR}/../lib/motor_link/include)
if(NOT EXISTS ${RB_MOTOR_LINK_DIR}/riskybird/motor_link.h)
  message(FATAL_ERROR
    "esp_bridge: the shared motor-link header is missing at ${RB_MOTOR_LINK_DIR}. "
    "It comes from workloads/lib/motor_link/ -- the same directory "
    "flight_controller --mode esp-motors passes as ROSE_MOTOR_LINK_DIR.")
endif()
target_include_directories(app PRIVATE ${RB_MOTOR_LINK_DIR})

# The motors build's duty ceiling, reachable from the build line. Same reason as
# workloads/esp_motors/CMakeLists.txt: RB_EXTRA_CFLAGS is dropped on this target
# (fpga_board=None), so a bare #ifndef in src/main.c could only ever be 25 %.
# Declared here, -DESP_LINK_MAX_DUTY_PCT=80 on the CMake line reaches the
# compiler. A cache variable: it persists in the build tree, so build a flight
# image into its own directory or with a pristine build, and read the value back
# from the boot banner ("duty ceiling NN%"). The default matches src/main.c.
set(ESP_LINK_MAX_DUTY_PCT 25 CACHE STRING
    "motors build: collective duty ceiling applied at the gate (percent)")
target_compile_definitions(app PRIVATE ESP_LINK_MAX_DUTY_PCT=${ESP_LINK_MAX_DUTY_PCT})

# Motors build: does the 120 ms silence failsafe also require a disarm -> arm
# edge before ARMED frames drive again (src/esp_safety_core.h)? 0 (default) =
# no, the next ARMED frame resumes (unlimited if the cut was < SS_CUT_COLD_MS,
# else through a cold spin-up) -- in flight the FC never disarms across a
# link gap. 1 = bench policy. Read back from the boot banner ("re-arm gate").
#   RB_CMAKE_ARGS="-DESP_LINK_REARM_AFTER_CUT=1"
set(ESP_LINK_REARM_AFTER_CUT 0 CACHE STRING
    "motors build: failsafe cut needs a re-arm edge (1/0)")
target_compile_definitions(app PRIVATE ESP_LINK_REARM_AFTER_CUT=${ESP_LINK_REARM_AFTER_CUT})

# Motors build, PWM phase interleave and spin-up gate: same mechanism, for
# bench A/B. 1 = on (default), 0 = off; read back from the boot banner
# ("PWM interleave ON/OFF", "spin-up gate ON/OFF") and RBLINK ph= / ss=. Cache
# variables persist, so build each variant pristine or into its own directory:
#   RB_CMAKE_ARGS="-DESP_LINK_PWM_INTERLEAVE=0 -DESP_LINK_SOFTSTART=0"
set(ESP_LINK_PWM_INTERLEAVE 1 CACHE STRING
    "motors build: spread the four LEDC on-edges over the period (1/0)")
set(ESP_LINK_SOFTSTART 1 CACHE STRING
    "motors build: spin-up gate on cold motors (1/0)")
target_compile_definitions(app PRIVATE
  ESP_LINK_PWM_INTERLEAVE=${ESP_LINK_PWM_INTERLEAVE}
  ESP_LINK_SOFTSTART=${ESP_LINK_SOFTSTART})
# The gate's numbers (riskybird/motor_softstart.h), passed only when given,
# e.g. -DSS_IDLE=1200 -DSS_HOLD_MS=60. Unset, the header defaults apply.
# SS_CUT_COLD_MS (300): a failsafe cut shorter than this resumes unlimited;
# one at least this long resumes through a cold spin-up.
foreach(ss_param SS_IDLE SS_HOLD_MS SS_RATE_PER_S SS_STAGGER_MS SS_MAX_MS SS_CUT_COLD_MS)
  if(DEFINED ${ss_param})
    target_compile_definitions(app PRIVATE ${ss_param}=${${ss_param}})
  endif()
endforeach()
```

## prj.conf
```kconfig
# ESP32-C6 WiFi bridge between the FPGA flight controller and a laptop.
#
# The networking settings below are not guesses: they are the configuration
# docs/TELEMETRY_BRINGUP.md in the Zephyr fork records as RELIABLE end-to-end
# (49.8 Hz, 0.3% loss, 0 gaps > 100 ms over a 3-minute soak). Three of them
# were the difference between "the SSID appears but I cannot connect" and a
# working link, so they are called out individually rather than tidied away.

CONFIG_UART_INTERRUPT_DRIVEN=y
CONFIG_SERIAL=y
CONFIG_RING_BUFFER=y

# ---- WiFi ------------------------------------------------------------------
CONFIG_WIFI=y
CONFIG_WIFI_ESP32=y
# Deterministic SINGLE-interface SoftAP. With AP_STA mode enabled the esp32
# driver registers two net_ifs and the first one is not necessarily the AP, so
# net_if_get_wifi_sap() and the DHCP server can end up on different interfaces.
CONFIG_ESP32_WIFI_AP_STA_MODE=n
CONFIG_NET_IF_MAX_IPV4_COUNT=1

# ---- Networking ------------------------------------------------------------
CONFIG_NETWORKING=y
CONFIG_NET_IPV4=y
CONFIG_NET_IPV6=n
CONFIG_NET_UDP=y
CONFIG_NET_SOCKETS=y
CONFIG_NET_DHCPV4_SERVER=y
CONFIG_NET_L2_ETHERNET=y
CONFIG_NET_CONFIG_SETTINGS=n

# The event handler reads the client MAC out of cb->info. Without this the info
# pointer is NULL, the handler faulted, and the symptom was "the SSID is
# visible but nothing can associate" -- which reads as a radio problem and is
# not one. The handler here NULL-guards it as well; both, not either.
CONFIG_NET_MGMT=y
CONFIG_NET_MGMT_EVENT=y
CONFIG_NET_MGMT_EVENT_INFO=y

# ---- Stacks ----------------------------------------------------------------
# The DHCP-time crash fix. The default 1024-byte system workqueue stack
# overflowed exactly when a client took a lease, so the link died at the moment
# it started working. Raised together with the net stacks rather than alone --
# they are on the same path and a fix to one just moves the overflow.
CONFIG_SYSTEM_WORKQUEUE_STACK_SIZE=4096
CONFIG_NET_MGMT_EVENT_STACK_SIZE=4096
CONFIG_NET_TX_STACK_SIZE=4096
CONFIG_NET_RX_STACK_SIZE=4096
CONFIG_MAIN_STACK_SIZE=4096

CONFIG_NET_PKT_RX_COUNT=24
CONFIG_NET_PKT_TX_COUNT=16
CONFIG_NET_BUF_RX_COUNT=64
CONFIG_NET_BUF_TX_COUNT=32

# ---- Diagnostics -----------------------------------------------------------
CONFIG_PRINTK=y
CONFIG_LOG=y
CONFIG_NET_LOG=y
CONFIG_THREAD_NAME=y
# printk goes through the deferred log (LOG_PRINTK). At the default 1024 B a
# bench log of one 4.4 h run showed 19 537 "messages dropped" events -- one of
# them the boot's reset-cause line -- and the RBLINK console copy now carries
# a reset/safety tail (~500 B per line at 5 Hz). 4 KiB of RAM buys that back.
CONFIG_LOG_BUFFER_SIZE=4096
# A bridge that silently stops forwarding is indistinguishable from a drone
# that stopped talking, so an overflow has to say so rather than be dropped.
CONFIG_STACK_SENTINEL=y

# The boot-time scheduler audit (sched_audit() in main.c) walks every thread and
# prints its priority. k_thread_foreach_unlocked() needs the kernel to keep the
# thread list, which is what this turns on. It is enabled for BOTH builds rather
# than only the motors one: in the plain bridge the list is merely interesting,
# but the whole point of the audit is that a Zephyr bump can silently change a
# networking thread's priority, and noticing that in the safe image -- before
# the same stack is flashed onto something that owns four motor gates -- is
# worth a few hundred bytes.
CONFIG_THREAD_MONITOR=y

# ---- Program loading (src/load_link.c) -------------------------------------
# TCP :14552 carries TSI program loads into the FPGA SoC. Two more descriptors
# and net contexts than the UDP bridge alone: the listener and one connection.
# The default 4 descriptors are already exactly consumed (DHCP server,
# socket-service eventfd, downlink, uplink), and the default 6 contexts would
# be exactly consumed in the motors build, which adds the status socket.
CONFIG_NET_TCP=y
CONFIG_ZVFS_OPEN_MAX=10
CONFIG_NET_MAX_CONTEXTS=10

# ---- Surviving a power cut (src/persist.c) -------------------------------
# Reset cause (only a power-on reset runs the boot policy), the image-1
# partition that holds the policy and the stashed program, and its CRC.
CONFIG_HWINFO=y
CONFIG_FLASH=y
CONFIG_FLASH_MAP=y
CONFIG_CRC=y

# The load service drains TCP at the FPGA link rate (11.5 KB/s). A small
# advertised window keeps a fast sender from filling every RX buffer (which
# also starves ARP and beacons); 2 KiB still allows ~400 KB/s at 5 ms RTT.
CONFIG_NET_TCP_MAX_RECV_WINDOW_SIZE=2048

# The WiFi driver allocates its dynamic RX/TX buffers (32 + 32, ~1.6 KB
# each) from the kernel heap, which defaults to ~45 KB here. Sustained
# traffic (a program load over WiFi) exhausted it: "esp32_wifi_adapter:
# memory allocation failed", dropped segments, multi-second TCP stalls.
CONFIG_HEAP_MEM_POOL_SIZE=98304

# Interrupt on every received byte. With the default threshold (22 bytes)
# replies shorter than that depend on the RX-timeout interrupt alone, and on
# the C6 they sat in the FIFO until the next burst pushed them out: a 2-4 byte
# flash-bridge or TSI reply arrived one command late.
CONFIG_UART_ESP32_RX_FIFO_THRESH=1
```

## src/esp_safety.c
```c
/*
 * SPDX-License-Identifier: Apache-2.0
 *
 * Crash safety and reset diagnostics for esp_bridge.
 *
 * ---------------------------------------------------------------------------
 * 1. FATAL ERROR -> GATES LOW -> RESET   (both builds; gates only in motors)
 * ---------------------------------------------------------------------------
 * Zephyr's default k_sys_fatal_error_handler halts. On this chip that is the
 * worst possible outcome: LEDC is free-running hardware, so a halted CPU leaves
 * all four gates at the last duty (up to the build's ceiling) while the 120 ms
 * failsafe, being a thread deadline, has died with the CPU. The override below
 *
 *   a. routes GPIO20-23 through the GPIO matrix to the plain GPIO_OUT bit, set
 *      LOW and output-enabled, then stops LEDC channels 0-3 at idle-low --
 *      register writes only, no kernel call, no driver semaphore, always_inline
 *      into an IRAM function so it works with the flash cache off;
 *   b. records the fault in RTC memory (kind, reason, mepc, uptime, thread);
 *   c. sets the IDF reset hint ESP_RST_PANIC and calls esp_restart_noos().
 *
 * esp_restart_noos() is a CPU-only reset (ROM reason 0x0C, RESET_REASON_CPU0_SW).
 * Its esp_system_reset_modules_on_exit() resets MSPI, UART0/1, SYSTIMER, GDMA,
 * SDIO slave, MCPWM, ETM and the modem -- NOT LEDC and NOT the GPIO/IO_MUX
 * block. So the GPIO-matrix override from (a) stays in force through the ROM
 * and the boot code, until pwm_led_esp32_init() applies pinctrl again -- with
 * every channel already stopped at idle-low (main.c's comment above
 * motors_off()). That property is read out of the hal source, not measured.
 * The hint makes the next boot's esp_reset_reason() ESP_RST_PANIC, i.e. hwinfo
 * RESET_CPU_LOCKUP, so persist.c does NOT treat it as a power-on.
 *
 * THE BOUND, stated honestly. The gates are forced low INSIDE this handler, so
 * the guarantee covers only faults that reach it. Zephyr runs its own code
 * first (exception entry, z_riscv_fatal_error, z_fatal_error -- flash
 * resident; conf/motors.conf sets CONFIG_EXCEPTION_DEBUG=n to drop the
 * register/stack dump from that path). If that path itself faults or hangs and
 * the handler is never reached, the only backstop is the watchdog's hardware
 * stage-1 reset at 2 x ESP_LINK_WDT_MS = 500 ms -- and only once the watchdog
 * is armed, i.e. after the first ARMED frame allowed to drive (section 2).
 * Before that, nothing has driven a gate since boot.
 *
 * No esp_rom_printf anywhere in here: the ROM console is UART0, and UART0 IS
 * the FPGA link (GPIO16 -> FPGA uart1 RX). No LOG_PANIC either: it can stall on
 * a USB CDC console nobody drains.
 *
 * ---------------------------------------------------------------------------
 * 2. HARDWARE WATCHDOG   (motors build: &wdt0 okay + CONFIG_WATCHDOG)
 * ---------------------------------------------------------------------------
 * TG0 MWDT, fed only from the motor-link thread. Started by the link thread at
 * the first ARMED frame the re-arm gate lets drive -- not at boot, where the
 * asynchronous WiFi bring-up and PHY calibration run -- and never stopped after
 * that (except the flash-erase hold below). RBLINK wdt=off until then.
 * Zephyr's wdt_esp32 programs
 * stage 0 = interrupt and stage 1 = the reset action, both at window.max, and
 * its ISR calls wdt_hal_handle_intr(), which FEEDS the dog -- so with a NULL
 * callback a stuck link thread would merely get fed every timeout, forever.
 * The callback here therefore does exactly what the fatal handler does (gates
 * low, record, hint ESP_RST_TASK_WDT, esp_restart_noos()). Timing:
 *
 *   ESP_LINK_WDT_MS (250)     stage 0: ISR -> gates low + reset. Covers a link
 *                             thread that is stuck, spinning or deadlocked
 *                             while interrupts still run.
 *   2 x ESP_LINK_WDT_MS       stage 1: hardware SYSTEM reset (ROM 0x07,
 *                             CORE_MWDT0), only reached if interrupts are
 *                             masked the whole time. A system reset DOES reset
 *                             LEDC and GPIO, so the pads fall back to their
 *                             IO_MUX reset state (see below), not forced-low.
 *
 * Units: the driver passes window.max straight through as MWDT ticks with
 * prescaler 40000. TG0's WDT clock select (PCR tg0_wdt_clk_sel) resets to 0 =
 * XTAL 40 MHz and nothing in this tree changes it, so 1 tick = 1 ms. The boot
 * line prints the register so the bench can confirm it ("wdtclk=0").
 *
 * Flash erases run with interrupts and cache off for a whole sector/64 KiB
 * block (esp_flash_erase_region brackets each op with spi1_start/end, which
 * irq_lock()s). A slow block erase could outlast the timeout, so persist.c
 * brackets every erase with esp_safety_wdt_hold() and does NOT erase unless
 * it is granted. The link thread grants it only after 1 s with no duty on any
 * gate -- the same window as load_link's motors-running refusal -- and, while
 * it is held, (a) the dog is disabled (or, if it was never started, cannot
 * be: esp_safety_wdt_start() returns -EAGAIN) and (b) motors_service() holds
 * every gate at 0 (esp_safety_wdt_held()). Single core + cooperative link
 * thread: between the grant and the release no duty can appear, so no erase
 * ever runs with the dog armed, nor with a gate driven while the failsafe is
 * stalled. Flash WRITES (page programs, ~1 ms with IRQs off each) need no
 * hold; persist.c refuses them while motors run.
 *
 * A JTAG halt (rb debug) also stops the feeding. OpenOCD's esp32c6 target
 * likely disables the MWDTs on halt (UNVERIFIED). If so, the dog may stay
 * disabled after the session resumes, and RBLINK wdt=<ms>ms -- which only
 * reports that this firmware started it -- cannot prove it is still live.
 * Power-cycle or reset after an rb debug session before trusting it.
 *
 * GPIO20-23 at reset: they are the SDIO_DATA0-3 pads (IO_MUX function 0 =
 * SDIO, function 1 = GPIO). The hal headers in this tree do not record the
 * IO_MUX reset pull configuration; whether a weak pull-up is on during reset is
 * UNVERIFIED here -- check the C6 datasheet IO MUX table and scope a gate
 * through a stage-1 / USB / power-on reset. With the carrier's 10 k pulldown a
 * ~45 k WPU would sit near 0.6 V at the SI2302 gate.
 *
 * ---------------------------------------------------------------------------
 * 3. RTC NOINIT RECORDS
 * ---------------------------------------------------------------------------
 * Four records in .rtc_noinit (LP SRAM), format in esp_safety_core.h:
 *   boot   boot counter
 *   snap   the running state, saved by the link thread every ESP_SAFETY_SNAP_MS
 *   fault  written by the fatal handler / watchdog callback
 *   kill   the ESP kill latch, written only on ESTOP and on the explicit RESET
 * They survive every reset that leaves LP SRAM powered (CPU/system/WDT/USB). On
 * a true power-on they are garbage and fail their check: "rtc=cold". Whether
 * they survive the C6's chip-level brownout (ROM 0x01, indistinguishable from
 * power-on by reason code) depends on how far the rail fell -- that is exactly
 * the evidence rtc=kept vs rtc=cold on an rst=0x01 boot provides. Not measured.
 */

#include "esp_safety.h"

#include <zephyr/kernel.h>
#include <zephyr/device.h>
#include <zephyr/devicetree.h>
#include <zephyr/fatal.h>
#include <zephyr/drivers/hwinfo.h>
#include <zephyr/sys/printk.h>
#include <string.h>

#include <esp_attr.h>
#include <esp_system.h>
#include <esp_rom_sys.h>
#include <esp_private/system_internal.h>
#include <soc/soc.h>
#include <soc/gpio_reg.h>
#include <soc/gpio_sig_map.h>
#include <soc/ledc_struct.h>
#include <soc/pcr_struct.h>

#define HAVE_MOTORS DT_NODE_EXISTS(DT_ALIAS(pwm_motor0))

#if HAVE_MOTORS && defined(CONFIG_WATCHDOG) && DT_NODE_HAS_STATUS_OKAY(DT_NODELABEL(wdt0))
#define HAVE_WDT 1
#include <zephyr/drivers/watchdog.h>
#else
#define HAVE_WDT 0
#endif

#ifndef ESP_SAFETY_SNAP_MS
#define ESP_SAFETY_SNAP_MS 10
#endif

/* ---- RTC records ----------------------------------------------------------- */

static RTC_NOINIT_ATTR volatile uint32_t rtc_boot[BOOT_NW];
static RTC_NOINIT_ATTR volatile uint32_t rtc_snap[SNAP_NW];
static RTC_NOINIT_ATTR volatile uint32_t rtc_fault[FAULT_NW];
static RTC_NOINIT_ATTR volatile uint32_t rtc_kill[KILL_NW];

/* What esp_safety_boot() captured. Read-only after boot. */
static uint32_t s_raw;           /* soc_reset_reason_t */
static uint32_t s_hw;            /* hwinfo RESET_* */
static uint32_t s_boots;
static bool     s_rtc_kept;
static bool     s_kill_restored;
static bool     s_prev_snap_ok;
static uint32_t s_prev_snap[SNAP_NW];
static bool     s_prev_fault_ok;
static uint32_t s_prev_fault[FAULT_NW];
static uint32_t s_wdt_clk_sel;

/* ---- the gates, with no kernel underneath -------------------------------- */

#if HAVE_MOTORS
#include <riskybird/motor_link.h>

/* Pins are the routed PCB's (esp_bridge-motors.overlay); channels are read
 * from the same devicetree the driver uses. Immediates only: this runs from
 * IRAM with the cache possibly off, so no lookup tables in flash rodata. */
#define GATE_PIN_LOW(pin)                                                       \
	do {                                                                    \
		REG_WRITE(GPIO_OUT_W1TC_REG, 1u << (pin));                      \
		REG_WRITE(GPIO_FUNC0_OUT_SEL_CFG_REG + (pin) * 4u, SIG_GPIO_OUT_IDX); \
		REG_WRITE(GPIO_ENABLE_W1TS_REG, 1u << (pin));                   \
	} while (0)

#define LEDC_STOP(ch)                                                           \
	do {                                                                    \
		LEDC.channel_group[0].channel[(ch)].conf0.idle_lv = 0;          \
		LEDC.channel_group[0].channel[(ch)].conf0.sig_out_en = 0;       \
		LEDC.channel_group[0].channel[(ch)].conf0.para_up = 1;          \
	} while (0)

static inline __attribute__((always_inline)) void gates_force_low(void)
{
	GATE_PIN_LOW(21);   /* MOTOR1 */
	GATE_PIN_LOW(20);   /* MOTOR2 */
	GATE_PIN_LOW(23);   /* MOTOR3 */
	GATE_PIN_LOW(22);   /* MOTOR4 */
	LEDC_STOP(DT_PWMS_CHANNEL(DT_ALIAS(pwm_motor0)));
	LEDC_STOP(DT_PWMS_CHANNEL(DT_ALIAS(pwm_motor1)));
	LEDC_STOP(DT_PWMS_CHANNEL(DT_ALIAS(pwm_motor2)));
	LEDC_STOP(DT_PWMS_CHANNEL(DT_ALIAS(pwm_motor3)));
}
#else
/* Default build: the gates belong to the FPGA (47 R in parallel on the
 * carrier) and this image hogs the pins as inputs. Driving them here would
 * fight the FPGA, so a fatal error only resets. */
static inline __attribute__((always_inline)) void gates_force_low(void)
{
}
#endif

/* ---- fault record + reset ---------------------------------------------------- */

static volatile uint32_t s_fault_depth;

static void fault_record(uint32_t kind, uint32_t reason, uint32_t pc)
{
	const char *name = k_thread_name_get(k_current_get());
	uint32_t nm[2] = { 0, 0 };

	if (name != NULL) {
		strncpy((char *)nm, name, sizeof(nm));
	}
	rtc_fault[FAULT_W_KIND] = kind;
	rtc_fault[FAULT_W_REASON] = reason;
	rtc_fault[FAULT_W_PC] = pc;
	rtc_fault[FAULT_W_UP_MS] = k_uptime_get_32();
	rtc_fault[FAULT_W_NAME0] = nm[0];
	rtc_fault[FAULT_W_NAME1] = nm[1];
	esp_rec_seal(rtc_fault, FAULT_NW, ESP_REC_FAULT_MAGIC);
}

/* Gates first, then the (flash-resident, possibly faulting) diagnostics, then
 * the reset. A fault inside fault_record() re-enters here with depth != 0 and
 * goes straight to the reset. */
static void IRAM_ATTR __attribute__((noreturn))
stop_and_restart(uint32_t kind, uint32_t reason, uint32_t pc, esp_reset_reason_t hint)
{
	gates_force_low();
	if (s_fault_depth++ == 0u) {
		fault_record(kind, reason, pc);
	}
	esp_reset_reason_set_hint(hint);
	esp_restart_noos();
	for (;;) {
	}
}

void IRAM_ATTR k_sys_fatal_error_handler(unsigned int reason, const struct arch_esf *esf)
{
	stop_and_restart(ESP_FAULT_FATAL, reason,
			 esf != NULL ? (uint32_t)esf->mepc : 0u, ESP_RST_PANIC);
}

/* ---- boot ------------------------------------------------------------------- */

const char *esp_safety_reset_name(uint32_t raw)
{
	switch (raw) {
	case 0x01: return "por/bod";    /* RESET_REASON_CHIP_POWER_ON == CHIP_BROWN_OUT */
	case 0x03: return "sw-sys";
	case 0x05: return "deepsleep";
	case 0x06: return "sdio";
	case 0x07: return "mwdt0-sys";
	case 0x08: return "mwdt1-sys";
	case 0x09: return "rtcwdt-sys";
	case 0x0B: return "mwdt0-cpu";
	case 0x0C: return "sw-cpu";
	case 0x0D: return "rtcwdt-cpu";
	case 0x0F: return "bod-sys";
	case 0x10: return "rtcwdt-rtc";
	case 0x11: return "mwdt1-cpu";
	case 0x12: return "superwdt";
	case 0x14: return "efuse-crc";
	case 0x15: return "usb-uart";
	case 0x16: return "usb-jtag";
	case 0x18: return "jtag-cpu";
	default:   return "unknown";
	}
}

static void rec_copy(uint32_t *dst, const volatile uint32_t *src, unsigned n)
{
	for (unsigned i = 0; i < n; i++) {
		dst[i] = src[i];
	}
}

void esp_safety_boot(void)
{
	s_raw = (uint32_t)esp_rom_get_reset_reason(0);
	(void)hwinfo_get_reset_cause(&s_hw);
	s_wdt_clk_sel = PCR.timergroup0_wdt_clk_conf.tg0_wdt_clk_sel;

	s_rtc_kept = esp_rec_valid(rtc_boot, BOOT_NW, ESP_REC_BOOT_MAGIC);
	s_boots = s_rtc_kept ? rtc_boot[BOOT_W_COUNT] + 1u : 1u;
	rtc_boot[BOOT_W_COUNT] = s_boots;
	esp_rec_seal(rtc_boot, BOOT_NW, ESP_REC_BOOT_MAGIC);

	/* Previous run's records: copy to RAM, then invalidate, so a record is
	 * only ever reported by the boot right after the run that wrote it. */
	s_prev_snap_ok = esp_rec_valid(rtc_snap, SNAP_NW, ESP_REC_SNAP_MAGIC);
	if (s_prev_snap_ok) {
		rec_copy(s_prev_snap, rtc_snap, SNAP_NW);
	}
	rtc_snap[SNAP_W_MAGIC] = 0u;
	s_prev_fault_ok = esp_rec_valid(rtc_fault, FAULT_NW, ESP_REC_FAULT_MAGIC);
	if (s_prev_fault_ok) {
		rec_copy(s_prev_fault, rtc_fault, FAULT_NW);
	}
	rtc_fault[FAULT_W_MAGIC] = 0u;

	/* The kill latch is NOT invalidated: it holds until the explicit RESET
	 * or a power-on that loses LP SRAM. Every boot rewrites it, so with LP
	 * SRAM kept (valid boot record) an invalid kill record means a store
	 * torn by a reset -- and the store most likely to be torn is the ESTOP's
	 * KILLED=1, made from the preemptible uplink thread. Fail closed: restore
	 * killed. Only a cold RTC (power-on garbage) defaults to not killed. */
	if (esp_rec_valid(rtc_kill, KILL_NW, ESP_REC_KILL_MAGIC)) {
		s_kill_restored = rtc_kill[KILL_W_KILLED] != 0u;
	} else if (s_rtc_kept) {
		s_kill_restored = true;
		esp_safety_kill_store(true);
		printk("esp_safety: kill record torn with RTC kept -> killed (RESET clears)\n");
	} else {
		esp_safety_kill_store(false);
	}

	char line[160];

	(void)esp_safety_boot_fields(line, sizeof(line));
	printk("esp_safety: boot%s kill=%u wdtclk=%u\n", line,
	       s_kill_restored ? 1u : 0u, (unsigned)s_wdt_clk_sel);
}

bool esp_safety_kill_restored(void)
{
	return s_kill_restored;
}

void esp_safety_kill_store(bool killed)
{
	rtc_kill[KILL_W_KILLED] = killed ? 1u : 0u;
	esp_rec_seal(rtc_kill, KILL_NW, ESP_REC_KILL_MAGIC);
}

uint32_t esp_safety_reset_raw(void)
{
	return s_raw;
}

uint32_t esp_safety_reset_hwinfo(void)
{
	return s_hw;
}

static int fault_str(char *buf, size_t len)
{
	char name[9];

	if (!s_prev_fault_ok) {
		return snprintk(buf, len, "none");
	}
	memcpy(name, &s_prev_fault[FAULT_W_NAME0], 8);
	name[8] = '\0';
	for (char *p = name; *p != '\0'; p++) {
		if (*p == ' ' || *p == '=') {
			*p = '_';
		}
	}
	if (s_prev_fault[FAULT_W_KIND] == ESP_FAULT_WDT) {
		return snprintk(buf, len, "wdt/%s/up%u", name[0] ? name : "?",
				(unsigned)s_prev_fault[FAULT_W_UP_MS]);
	}
	return snprintk(buf, len, "fatal%u/pc%08x/%s/up%u",
			(unsigned)s_prev_fault[FAULT_W_REASON],
			(unsigned)s_prev_fault[FAULT_W_PC], name[0] ? name : "?",
			(unsigned)s_prev_fault[FAULT_W_UP_MS]);
}

int esp_safety_boot_fields(char *buf, size_t len)
{
	char f[64];

	(void)fault_str(f, sizeof(f));
	return snprintk(buf, len, " rst=0x%02x(%s) hw=0x%x bootn=%u rtc=%s prev_fault=%s",
			(unsigned)s_raw, esp_safety_reset_name(s_raw), (unsigned)s_hw,
			(unsigned)s_boots, s_rtc_kept ? "kept" : "cold", f);
}

/* ---- motors build: snapshot and watchdog ------------------------------------ */

#if HAVE_MOTORS
void esp_safety_snap_store(const volatile uint16_t duty[4], uint8_t flags,
			   bool kill, bool link_up, uint8_t hold)
{
	static uint32_t last;
	uint32_t now = k_uptime_get_32();

	if (last != 0u && (uint32_t)(now - last) < ESP_SAFETY_SNAP_MS) {
		return;
	}
	last = now != 0u ? now : 1u;
	rtc_snap[SNAP_W_UP_MS] = now;
	rtc_snap[SNAP_W_DUTY01] = (uint32_t)duty[0] | ((uint32_t)duty[1] << 16);
	rtc_snap[SNAP_W_DUTY23] = (uint32_t)duty[2] | ((uint32_t)duty[3] << 16);
	rtc_snap[SNAP_W_STATE] = esp_snap_state(flags, kill, link_up, hold);
	esp_rec_seal(rtc_snap, SNAP_NW, ESP_REC_SNAP_MAGIC);
}

int esp_safety_prev_fields(char *buf, size_t len)
{
	if (!s_prev_snap_ok) {
		return snprintk(buf, len, " prev_up=none");
	}
	uint32_t st = s_prev_snap[SNAP_W_STATE];

	return snprintk(buf, len,
			" prev_up=%u prev_duty=[%u %u %u %u] prev_fl=0x%02x prev_kill=%u"
			" prev_ml=%s prev_hold=%s",
			(unsigned)s_prev_snap[SNAP_W_UP_MS],
			(unsigned)(s_prev_snap[SNAP_W_DUTY01] & 0xffffu),
			(unsigned)(s_prev_snap[SNAP_W_DUTY01] >> 16),
			(unsigned)(s_prev_snap[SNAP_W_DUTY23] & 0xffffu),
			(unsigned)(s_prev_snap[SNAP_W_DUTY23] >> 16),
			(unsigned)(st & 0xffu), (unsigned)((st >> 8) & 1u),
			((st >> 9) & 1u) ? "up" : "down",
			esp_rearm_hold_name((uint8_t)((st >> 12) & 0x7u)));
}
#else
void esp_safety_snap_store(const volatile uint16_t duty[4], uint8_t flags,
			   bool kill, bool link_up, uint8_t hold)
{
	ARG_UNUSED(duty); ARG_UNUSED(flags); ARG_UNUSED(kill);
	ARG_UNUSED(link_up); ARG_UNUSED(hold);
}

int esp_safety_prev_fields(char *buf, size_t len)
{
	return snprintk(buf, len, " prev_up=none");
}
#endif

#if HAVE_WDT
static const struct device *const wdt_dev = DEVICE_DT_GET(DT_NODELABEL(wdt0));
static atomic_t wdt_hold_req = ATOMIC_INIT(0);
static atomic_t wdt_held = ATOMIC_INIT(0);
static bool wdt_running;   /* link thread only */
static atomic_t wdt_started = ATOMIC_INIT(0);

/* Stage 0 expired: the link thread has not fed for ESP_LINK_WDT_MS. ISR
 * context (the driver's TG0 WDT interrupt). Never returns. */
static void wdt_expired(const struct device *dev, int channel_id)
{
	ARG_UNUSED(dev);
	ARG_UNUSED(channel_id);
	stop_and_restart(ESP_FAULT_WDT, 0u, 0u, ESP_RST_TASK_WDT);
}

int esp_safety_wdt_start(void)
{
	/* Not under a flash-erase hold: the caller retries on the next frame. */
	if (atomic_get(&wdt_hold_req) != 0 || atomic_get(&wdt_held) != 0) {
		return -EAGAIN;
	}
	struct wdt_timeout_cfg cfg = {
		.window = { .min = 0u, .max = ESP_LINK_WDT_MS },
		.callback = wdt_expired,
		.flags = WDT_FLAG_RESET_SOC,
	};
	int rc;

	if (!device_is_ready(wdt_dev)) {
		return -ENODEV;
	}
	rc = wdt_install_timeout(wdt_dev, &cfg);
	if (rc < 0) {
		return rc;
	}
	rc = wdt_setup(wdt_dev, 0);
	if (rc < 0) {
		return rc;
	}
	wdt_running = true;
	atomic_set(&wdt_started, 1);
	return 0;
}

/* Runs whether or not the dog has started: a hold also has to keep an
 * unstarted dog from starting (and the gates at 0) for the erase. */
void esp_safety_wdt_service(bool motors_on)
{
	bool req = atomic_get(&wdt_hold_req) != 0;
	bool held = atomic_get(&wdt_held) != 0;

	if (req && !held && !motors_on) {
		if (wdt_running) {
			(void)wdt_disable(wdt_dev);
			wdt_running = false;
		}
		atomic_set(&wdt_held, 1);
	} else if (held && (!req || motors_on)) {
		/* Released. (motors_on cannot become true while held --
		 * motors_service() blocks every gate -- but if it ever did, the
		 * dog comes back at once.) */
		if (atomic_get(&wdt_started)) {
			(void)wdt_setup(wdt_dev, 0);
			wdt_running = true;
		}
		atomic_set(&wdt_held, 0);
	}
	if (wdt_running) {
		(void)wdt_feed(wdt_dev, 0);
	}
}

bool esp_safety_wdt_hold(bool on)
{
	atomic_set(&wdt_hold_req, on ? 1 : 0);
	/* The link thread services the request within one tick (5 ms). */
	for (int i = 0; i < 20; i++) {
		if ((atomic_get(&wdt_held) != 0) == on) {
			break;
		}
		k_msleep(5);
	}
	return atomic_get(&wdt_held) != 0;
}

bool esp_safety_wdt_held(void)
{
	return atomic_get(&wdt_held) != 0;
}

const char *esp_safety_wdt_state(void)
{
	if (atomic_get(&wdt_held)) {
		return "held";
	}
	return atomic_get(&wdt_started) ? STRINGIFY(ESP_LINK_WDT_MS) "ms" : "off";
}
#else
int esp_safety_wdt_start(void)
{
	return -ENOTSUP;
}

void esp_safety_wdt_service(bool motors_on)
{
	ARG_UNUSED(motors_on);
}

/* No watchdog and (in the default build) no gates: an erase is always safe
 * as far as this file is concerned; persist.c still refuses while motors run. */
bool esp_safety_wdt_hold(bool on)
{
	return on;
}

bool esp_safety_wdt_held(void)
{
	return false;
}

const char *esp_safety_wdt_state(void)
{
	return "off";
}
#endif
```

## src/esp_safety.h
```c
/*
 * SPDX-License-Identifier: Apache-2.0
 *
 * Crash safety and reset diagnostics for esp_bridge. See esp_safety.c.
 */
#ifndef RISKYBIRD_ESP_BRIDGE_ESP_SAFETY_H
#define RISKYBIRD_ESP_BRIDGE_ESP_SAFETY_H

#include <stdbool.h>
#include <stddef.h>
#include <stdint.h>

#include "esp_safety_core.h"

/* Motors build: hardware watchdog stage-0 timeout (interrupt -> gates low ->
 * reset). The hardware-only reset backstop is twice this. 1 MWDT tick = 1 ms
 * (TG0 WDT clock = XTAL, prescaler 40000 in wdt_esp32.c). */
#ifndef ESP_LINK_WDT_MS
#define ESP_LINK_WDT_MS 250
#endif

/* Once, first thing in main(): reads the ROM reset reason, the hwinfo cause and
 * the RTC records left by the previous run, bumps the boot counter and prints
 * one summary line. Everything below reports what this captured. */
void esp_safety_boot(void);

/* True if the previous run left the ESP kill latch SET in RTC memory (an
 * ESTOP that no RESET has cleared). main() restores g_kill from it. */
bool esp_safety_kill_restored(void);

/* Record the kill latch in RTC memory. From the uplink thread, on ESTOP (true)
 * and on the explicit RESET (false). */
void esp_safety_kill_store(bool killed);

/* Raw ROM reset reason (soc_reset_reason_t) and the hwinfo RESET_* mask. */
uint32_t esp_safety_reset_raw(void);
uint32_t esp_safety_reset_hwinfo(void);
const char *esp_safety_reset_name(uint32_t raw);

/* Appends " rst=0x.. (name) hw=0x.. bootn=N rtc=kept|cold prev_fault=..."
 * (both builds) to buf. Returns the snprintk count. */
int esp_safety_boot_fields(char *buf, size_t len);

/* ---- motors build only (no-ops / zeros in the default build) ------------- */

/* Link thread only, every loop: saves the previous-run snapshot (uptime,
 * applied duties, flags, kill, link, re-arm hold) to RTC memory, at most once
 * every ESP_SAFETY_SNAP_MS. */
void esp_safety_snap_store(const volatile uint16_t duty[4], uint8_t flags,
			   bool kill, bool link_up, uint8_t hold);

/* Appends " prev_up=.. prev_duty=[....] prev_fl=0x.. prev_kill=. prev_ml=.."
 * describing the snapshot the previous run left, or " prev_up=none". */
int esp_safety_prev_fields(char *buf, size_t len);

/* Hardware watchdog on TG0 MWDT. Link thread only: start once, at the first
 * ARMED frame allowed to drive (main.c handle_frame; -EAGAIN while a hold is
 * requested or granted, retried on the next frame), then service on every
 * loop pass (feeds, and grants/releases a hold request -- see below; that
 * part runs before the start too).
 * `motors_on` is esp_bridge_motors_recently_on(). */
int esp_safety_wdt_start(void);
void esp_safety_wdt_service(bool motors_on);

/* From any thread EXCEPT the link thread: ask for the watchdog to be paused
 * around a long interrupts-off operation (a flash erase), started or not.
 * The link thread grants it only after 1 s with no duty on any gate; while
 * held, the dog is disabled or cannot start, and the gates are held at 0.
 * Waits <= 100 ms. on=true returns true = granted, i.e. safe to erase (false:
 * do NOT erase); always release with on=false, granted or not. Without a
 * watchdog (default build) it returns `on` at once. */
bool esp_safety_wdt_hold(bool on);

/* True while a hold is granted: motors_service() holds every gate at 0. */
bool esp_safety_wdt_held(void);

/* "off" | "<ms>ms" | "held" -- for the RBLINK line. */
const char *esp_safety_wdt_state(void);

#endif
```

## src/esp_safety_core.h
```c
/*
 * SPDX-License-Identifier: Apache-2.0
 *
 * The pure half of esp_safety.c: the re-arm gate and the RTC record format.
 *
 * Freestanding on purpose -- stdint/stdbool and nothing else -- so the host
 * test (tests/test_esp_safety.py, tests/esp_safety_check.c) compiles exactly
 * this file and exercises the rules that cannot be checked without a board.
 * Everything here is static inline and touches no hardware.
 */
#ifndef RISKYBIRD_ESP_SAFETY_CORE_H
#define RISKYBIRD_ESP_SAFETY_CORE_H

#include <stdbool.h>
#include <stdint.h>

/* ---- the re-arm gate ------------------------------------------------------
 *
 * The rule: after any event that cut the gates without the sender asking, an
 * ARMED frame is not enough to drive again. The sender has to be seen NOT
 * armed at least once first, and then armed: a disarm -> arm edge, i.e. a
 * human (or the FC's own logic) deciding to arm again. Without it, an ESP
 * reset or a kill-clear while the FC is still sending ARMED frames steps the
 * gates straight back to the commanded duty.
 *
 * The events that set the hold:
 *   BOOT  every boot, whatever the reset cause (an ESP reboot already means
 *         >1 s without thrust, so requiring a re-arm loses nothing)
 *   KILL  the ESP kill latch was SET (UDP ESTOP). Clearing it (RESET) does
 *         not add a hold of its own: a plain RESET with no latch is the rig's
 *         routine arm command and must change nothing.
 *   CUT   the 120 ms silence failsafe fired -- ONLY when the build sets
 *         ESP_LINK_REARM_AFTER_CUT=1 (esp_rearm_on_cut). Off by default: in
 *         flight the FC keeps sending ARMED across a link gap and never
 *         disarms, so a CUT hold would keep the motors off for good after a
 *         120 ms hiccup. By default the cut only zeroes the gates and the next
 *         valid ARMED frame resumes (unlimited if the cut was shorter than
 *         SS_CUT_COLD_MS, through a cold spin-up if longer: motor_softstart.h).
 *
 * What counts as "not armed": a valid frame with ARMED clear, or with any
 * MOTOR_LINK_FLAGS_BLOCK bit set (the sender then forces ARMED clear anyway).
 * An ARMED frame received while the kill latch is set CLEARS the disarm
 * evidence, so a sender that never disarmed across the whole kill has to
 * disarm once after RESET before it can drive.
 */
enum esp_rearm_hold {
	ESP_REARM_NONE = 0,
	ESP_REARM_BOOT = 1,
	ESP_REARM_CUT  = 2,
	ESP_REARM_KILL = 3,
};

struct esp_rearm {
	uint8_t  hold;          /* enum esp_rearm_hold; NONE = frames may drive */
	bool     disarm_seen;   /* a not-armed frame arrived since the hold was set */
	uint32_t blocked;       /* ARMED frames refused by the hold, since boot */
};

static inline void esp_rearm_init(struct esp_rearm *r)
{
	r->hold = ESP_REARM_BOOT;
	r->disarm_seen = false;
	r->blocked = 0u;
}

static inline void esp_rearm_hold(struct esp_rearm *r, uint8_t why)
{
	r->hold = why;
	r->disarm_seen = false;
}

/* The silence failsafe just cut the gates. `rearm_after_cut` is the build's
 * ESP_LINK_REARM_AFTER_CUT: false leaves the gate as it was (frames resume),
 * true sets the CUT hold. */
static inline void esp_rearm_on_cut(struct esp_rearm *r, bool rearm_after_cut)
{
	if (rearm_after_cut) {
		esp_rearm_hold(r, ESP_REARM_CUT);
	}
}

/* One valid, in-sequence frame. `armed_bit` and `block_mask` are the
 * MOTOR_LINK_FLAG_ARMED / MOTOR_LINK_FLAGS_BLOCK values (passed in so this
 * header does not depend on motor_link.h). Returns true only if this frame
 * may drive the gates. */
static inline bool esp_rearm_frame(struct esp_rearm *r, uint8_t flags,
				   uint8_t armed_bit, uint8_t block_mask,
				   bool killed)
{
	bool wants_drive = (flags & armed_bit) != 0u && (flags & block_mask) == 0u;

	if (!wants_drive) {
		r->disarm_seen = true;
		return false;
	}
	if (killed) {
		r->disarm_seen = false;
		return false;
	}
	if (r->hold != ESP_REARM_NONE) {
		if (!r->disarm_seen) {
			r->blocked++;
			return false;
		}
		r->hold = ESP_REARM_NONE;   /* the disarm -> arm edge */
	}
	return true;
}

static inline const char *esp_rearm_hold_name(uint8_t hold)
{
	switch (hold) {
	case ESP_REARM_NONE: return "0";
	case ESP_REARM_BOOT: return "boot";
	case ESP_REARM_CUT:  return "cut";
	case ESP_REARM_KILL: return "kill";
	default:             return "?";
	}
}

/* ---- RTC records ------------------------------------------------------------
 *
 * Every record is an array of 32-bit words: word 0 a per-record magic, the
 * last word a check over all the others. Word-only so every store to LP SRAM
 * is a single aligned 32-bit write, and so a write torn by a reset is caught
 * by the check rather than half-trusted.
 *
 * On a true power-on LP SRAM holds whatever the cells settled to, so the magic
 * plus a 32-bit check rejects it with overwhelming probability -- which is
 * also exactly how "the rail collapsed far enough to lose RTC RAM" shows up
 * (rtc=cold), as opposed to a dip that reset the chip but kept it (rtc=kept).
 */
#define ESP_REC_BOOT_MAGIC  0x52424254u   /* "RBBT" */
#define ESP_REC_SNAP_MAGIC  0x52425350u   /* "RBSP" */
#define ESP_REC_FAULT_MAGIC 0x52424654u   /* "RBFT" */
#define ESP_REC_KILL_MAGIC  0x52424b4cu   /* "RBKL" */

/* FNV-1a over 32-bit words, seeded with the magic so two record types with
 * equal payloads never validate as each other, with a right-shift fold after
 * every multiply and a murmur3 fmix32 at the end. Plain FNV over whole words
 * only carries upward, so bit 31 of the hash depended on bit 31 of each word
 * alone: the same high bit flipped in two words validated (~100 % for bit 31,
 * 41 % for bit 30; tests/esp_safety_fuzz_check.c). The folds make every bit
 * depend on every bit. Changing the function invalidates the records written
 * by an older image once (that boot reads rtc=cold). always_inline, no calls,
 * no tables: the fatal handler runs it from IRAM and must not touch flash. */
static inline __attribute__((always_inline))
uint32_t esp_rec_check(const volatile uint32_t *w, unsigned nwords)
{
	uint32_t h = 2166136261u ^ w[0];

	for (unsigned i = 1; i + 1u < nwords; i++) {
		h = (h ^ w[i]) * 16777619u;
		h ^= h >> 15;
	}
	h ^= h >> 16;
	h *= 0x85ebca6bu;
	h ^= h >> 13;
	h *= 0xc2b2ae35u;
	h ^= h >> 16;
	return ~h;
}

static inline __attribute__((always_inline))
void esp_rec_seal(volatile uint32_t *w, unsigned nwords, uint32_t magic)
{
	w[0] = magic;
	w[nwords - 1u] = esp_rec_check(w, nwords);
}

static inline bool esp_rec_valid(const volatile uint32_t *w, unsigned nwords,
				 uint32_t magic)
{
	return w[0] == magic && w[nwords - 1u] == esp_rec_check(w, nwords);
}

/* Record layouts (word indices). */
enum { BOOT_W_MAGIC, BOOT_W_COUNT, BOOT_W_CHECK, BOOT_NW };

enum {
	SNAP_W_MAGIC,
	SNAP_W_UP_MS,     /* k_uptime at the store */
	SNAP_W_DUTY01,    /* duty[0] | duty[1] << 16, per 10000, as applied */
	SNAP_W_DUTY23,
	SNAP_W_STATE,     /* see esp_snap_state() */
	SNAP_W_CHECK,
	SNAP_NW
};

enum {
	FAULT_W_MAGIC,
	FAULT_W_KIND,     /* ESP_FAULT_* */
	FAULT_W_REASON,   /* k_fatal reason code (FATAL), 0 for WDT */
	FAULT_W_PC,       /* mepc of the faulting context, 0 if unknown */
	FAULT_W_UP_MS,
	FAULT_W_NAME0,    /* first 8 chars of the running thread's name */
	FAULT_W_NAME1,
	FAULT_W_CHECK,
	FAULT_NW
};

enum { KILL_W_MAGIC, KILL_W_KILLED, KILL_W_CHECK, KILL_NW };

#define ESP_FAULT_FATAL 1u
#define ESP_FAULT_WDT   2u

/* SNAP_W_STATE: the sender's flag byte, then one bit each for the kill latch
 * and link-up, then the re-arm hold. */
static inline uint32_t esp_snap_state(uint8_t flags, bool kill, bool link_up,
				      uint8_t hold)
{
	return (uint32_t)flags | ((uint32_t)kill << 8) | ((uint32_t)link_up << 9) |
	       ((uint32_t)(hold & 0x7u) << 12);
}

#endif /* RISKYBIRD_ESP_SAFETY_CORE_H */
```

## src/load_link.h
```c
/*
 * SPDX-License-Identifier: Apache-2.0
 *
 * Remote program loading through the FPGA link. See load_link.c.
 */
#ifndef RISKYBIRD_ESP_BRIDGE_LOAD_LINK_H
#define RISKYBIRD_ESP_BRIDGE_LOAD_LINK_H

#include <stdbool.h>
#include <stddef.h>
#include <stdint.h>
#include <zephyr/device.h>

/* TCP port of the WiFi load service. */
#define LOAD_LINK_TCP_PORT 14552

/* True from the moment a load session claims the FPGA wire until the FPGA's
 * mux has idled back to uart1. While true: every byte from the FPGA belongs to
 * the session (hand it to load_link_rx_from_fpga, not the telemetry path),
 * nothing else may write the FPGA UART, and the motor gates must read zero.
 * ISR-safe. */
bool load_link_active(void);

/* From the FPGA UART ISR while load_link_active(). */
void load_link_rx_from_fpga(const uint8_t *buf, size_t n);

/* Every writer of the FPGA UART outside a session holds this lock while it
 * writes, so a session never starts its break in the middle of someone else's
 * line. Never blocks for a session: false means one has the wire (or is taking
 * it), and the caller must drop what it wanted to send, not queue it -- queued
 * bytes would reach whatever program the session just loaded. */
bool load_link_tx_trylock(void);
void load_link_tx_unlock(void);

/* Provided by main.c: true while, or within 1 s after, any motor gate carried
 * a nonzero duty. Every session is refused then. */
bool esp_bridge_motors_recently_on(void);

/* Provided by main.c: the current RBLINK health line, newline-terminated
 * (what the motor frames last said, e.g. fl=0x20 COMMITTED). */
int esp_bridge_status(char *buf, size_t len);

/* Provided by main.c: uart1 bytes received outside sessions since boot. */
uint32_t esp_bridge_uart1_rx_bytes(void);

/* Starts the session thread: TCP :LOAD_LINK_TCP_PORT and the USB tunnel.
 * `usb` may be NULL (no tunnel). */
int load_link_start(const struct device *fpga_uart, const struct device *usb);

#endif
```

## src/load_link_internal.h
```c
/*
 * SPDX-License-Identifier: Apache-2.0
 *
 * Shared between load_link.c (sessions on the FPGA link) and persist.c
 * (power-on boot policy and the stashed program). Not a public API.
 */
#ifndef RISKYBIRD_ESP_BRIDGE_LOAD_LINK_INTERNAL_H
#define RISKYBIRD_ESP_BRIDGE_LOAD_LINK_INTERNAL_H

#include <stdbool.h>
#include <stddef.h>
#include <stdint.h>

enum kind { K_LOAD, K_POKE, K_PING, K_FLASH, K_BOOT, K_STAT, K_STASH, K_POLICY, K_AUTO };

struct request {
	enum kind kind;
	bool fast;
	uint32_t addr;
	uint8_t mode;     /* BOOT: ICAP sequence, see EspLinkIprog (0 = IPROG) */
	char args[48];
};

/* Claim the FPGA wire (motors read zero, uplink refused, RX diverted). */
void ll_claim(void);
/* Give it back; end_break: hand the mux back to uart1 with a bare break. */
void ll_release(bool end_break);
/* Break + key (+ boot address) + ack. LOAD also waits out the SoC reset. */
bool ll_handshake(enum kind kind, uint32_t addr, uint32_t *id, bool *id_valid);
void ll_write(const uint8_t *b, size_t n);
size_t ll_read(uint8_t *b, size_t n, int timeout_ms);

/* The host transport of the current session (sock NULL for USB). */
int ll_send(int *sock, bool is_usb, const char *s);
int ll_recv(int *sock, bool is_usb, uint8_t *buf, size_t max);

/* persist.c */
void persist_session(int *sock, bool is_usb, const struct request *rq);
void persist_start(void);

#endif
```

## src/sensor_relay.h
```c
/*
 * SPDX-License-Identifier: Apache-2.0
 *
 * Sensor relay (motors build, ESP_SENSOR_RELAY): see sensor_relay.c.
 */
#ifndef ESP_BRIDGE_SENSOR_RELAY_H
#define ESP_BRIDGE_SENSOR_RELAY_H

#include <stdbool.h>
#include <stddef.h>

/* Start the relay threads. They idle until the first keepalive; call once from main(). */
void sensor_relay_start(void);

/* The FC asked for frames (its RELAY_KEEPALIVE_LINE arrived). Any thread. */
void sensor_relay_keepalive(void);

/* One status line (with its newline) for the status thread to print and send. */
int sensor_relay_status(char *buf, size_t len);

/* main.c's TX path to the FPGA: whole buffer under the TX lock, false while a load session
 * owns the wire. */
bool esp_bridge_fpga_write(const char *s, size_t len);

#endif /* ESP_BRIDGE_SENSOR_RELAY_H */
```
