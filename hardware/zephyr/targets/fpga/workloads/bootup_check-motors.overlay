/*
 * Bootup check with the motor sweep. PROPELLERS OFF, BATTERY REQUIRED.
 *
 * Nothing to add over the default overlay: the sweep goes through the ESP link
 * (esp-uart alias, from fpga-esp-uart.overlay, which rb appends for any shell
 * that elaborates serial@10021000), and no FPGA PWM channel is declared, so this
 * image cannot drive a motor pin. Until 2026-11-03 this file declared the
 * pwm-motor1..4 aliases for the FPGA PWM path; see main.c stage 8 for why that
 * path was retired.
 */

#include "bootup_check.overlay"
